## boards/arm/nicenano_v20/Kconfig.nicenano_v20
```kconfig
# Copyright (c) 2025 MLesniak https://github.com/LesniakM

config BOARD_NICENANO_V20
	select SOC_NRF52840_QIAA
    select ARCH_ARM
```

## boards/arm/nicenano_v20/board.yml
```yaml
# Copyright (c) 2025 MLesniak https://github.com/LesniakM

board:
  name: nicenano_v20
  vendor: nice!
  socs:
  - name: nrf52840
```

## boards/arm/nicenano_v20/nicenano_v20_nrf52840_defconfig
```kconfig
# Copyright (c) 2025 MLesniak https://github.com/LesniakM

# Enable hardware stack protection
# CONFIG_HW_STACK_PROTECTION=y

# Enable MPU
# CONFIG_ARM_MPU=y
```
